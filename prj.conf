## CMakeLists.txt
```
cmake_minimum_required(VERSION 3.20.0)

find_package(Zephyr REQUIRED HINTS $ENV{ZEPHYR_BASE})
project(stm32wle5_rtos_vref)

FILE(GLOB app_sources src/*.c)
target_sources(app PRIVATE ${app_sources})
```

## prj.conf
```kconfig
# Debugger support
CONFIG_UART_CONSOLE=y
CONFIG_CONSOLE=y

# Communication Bus Support
CONFIG_GPIO=y
CONFIG_SPI=y

# Hardware Support
CONFIG_SENSOR=y
CONFIG_ADC=y

# Power Management Support
CONFIG_PM=y
CONFIG_PM_DEVICE=y
CONFIG_PM_DEVICE_RUNTIME=y
CONFIG_PM_DEVICE_RUNTIME_EXCLUSIVE=n
```

## boards/stm32wl_dw1000_iot_board.overlay
```dts
/*
 * Copyright (c) 2023
 * Regis Rousseau
 * Univ Lyon, INSA Lyon, Inria, CITI, EA3720
 * SPDX-License-Identifier: Apache-2.0
 */

/* VREF internal voltage monitoring */
/* internal voltage reference of STM32, IN13 - see datasheet pg 42/149 */
/* Vrefint = 1232mV max - see datasheet pg 78/149, table 36 */
/ {
	stm32_vref: stm32vref {
    	compatible = "st,stm32-vref";
		io-channels = <&adc1 13>;
		vrefint-cal-addr = <13>;
		vrefint-cal-mv = <1232>;
    	status = "okay";
	};
};

/* VBAT battery voltage monitoring - see datasheet pg 42/149, part 3.18.3 */
/* internal ADC channnel of STM32, IN14 */
/* ratio = 3 -> the converted digital value is 1/3 of vbat */
/ {
	stm32_vbat: stm32vbat {
    	compatible = "st,stm32-vbat";
    	io-channels = <&adc1 14>;
   		ratio = <3>;
    	status = "okay";
	};
};
```

## src/main.c
```c
/*
 * Copyright (c) 2023
 * Regis Rousseau
 * Univ Lyon, INSA Lyon, Inria, CITI, EA3720
 * SPDX-License-Identifier: Apache-2.0
 */

#include "app_vref.h"
#include "app_vbat.h"

//  ======== main ===============================================
int main(void)
{
	const struct device *vref_dev = NULL;
	const struct device *vbat_dev = NULL;

	// setup all devices
	vref_dev = DEVICE_DT_GET_ONE(st_stm32_vref);
	vbat_dev = DEVICE_DT_GET_ONE(st_stm32_vbat);
	app_stm32_vref_init(vref_dev);
	app_stm32_vbat_init(vbat_dev);
	
	printk("Internal Voltage Reference and Battery Example\nBoard: %s\n", CONFIG_BOARD);

	while (1) {
		uint16_t vref = app_stm32_get_vref(vref_dev);
		uint16_t vbat = app_stm32_get_vbat(vbat_dev, vref);
		k_sleep(K_MSEC(2000));
	}
	return 0;
}
```

## src/app_vbat.h
```c
/*
 * Copyright (c) 2023
 * Regis Rousseau
 * Univ Lyon, INSA Lyon, Inria, CITI, EA3720
 * SPDX-License-Identifier: Apache-2.0
 */

#ifndef APP_VBAT_H
#define APP_VBAT_H

//  ======== includes ==============================================
#include <zephyr/kernel.h>
#include <zephyr/device.h>
#include <zephyr/drivers/sensor.h>

//  ======== prototypes ============================================
int8_t app_stm32_vbat_init(const struct device *dev);
uint16_t app_stm32_get_vbat(const struct device *dev, uint16_t val);

#endif /* APP_VBAT_H */
```

## src/app_vref.c
```c
/*
 * Copyright (c) 2023
 * Regis Rousseau
 * Univ Lyon, INSA Lyon, Inria, CITI, EA3720
 * SPDX-License-Identifier: Apache-2.0
 */

#include "app_vref.h"

//  ======== app_stm32_vbat_init ============================================
int8_t app_stm32_vref_init(const struct device *dev)
{
    // getting internal vbat ADC device at GPIO IN5 - PB1
    dev = DEVICE_DT_GET_ONE(st_stm32_vref);

    if (dev == NULL) {
        printk("error: no stm32 vref device found\n");
		return 0;
	}

    if (!device_is_ready(dev)) {
		printk("error: stm32 vref is not ready\n");
		return 0;
	} else {
        printk("- found device \"%s\", getting vref data\n", dev->name);
    }
    return 0;
}

//  ======== app_stm32_get_vbat =============================================
uint16_t app_stm32_get_vref(const struct device *dev)
{
    struct sensor_value vref_int32;
    uint16_t vref_uint16;
    int8_t ret = 0;

    // fetching data
    ret = sensor_sample_fetch(dev);
    if (ret < 0 && ret != -EBADMSG) {        
	    printk("error: stm32 vref sample is not up to date\n");
	    return 0;
    }

    // getting channel function
	ret = sensor_channel_get(dev, SENSOR_CHAN_VOLTAGE, &vref_int32);
    if (ret < 0) {
        printk("error: can't read sensor channels\n");
	    return 0;
    }

    // reference level received and converted from channel get
    // resolution 12bits: 0 to 4095 (uint16)
    vref_uint16 = (uint16_t)(sensor_value_to_milli(&vref_int32));
    printk("stm32 vbat: %"PRIu16"\n", vref_uint16);
    return vref_uint16;
}
```
